// SPDX-License-Identifier: GPL-2.0+
/*
 * Copyright (C) 2018 Jagan Teki <jagan@amarulasolutions.com>
 */

#include "imx6qdl-u-boot.dtsi"

&usdhc4 {
	u-boot,dm-spl;
};

&pinctrl_usdhc4 {
	u-boot,dm-spl;
};
